#include "willow.dtsi"

&default_transform {
    col-offset = <0>;
};

&kscan0 {
    diode-direction = "col2row";
    wakeup-source;
    col-gpios
        = <&pro_micro 21 GPIO_ACTIVE_HIGH>
        , <&pro_micro 20 GPIO_ACTIVE_HIGH>
        , <&pro_micro 19 GPIO_ACTIVE_HIGH>
        , <&pro_micro 18 GPIO_ACTIVE_HIGH>
        , <&pro_micro 9 GPIO_ACTIVE_HIGH>
        , <&pro_micro 8 GPIO_ACTIVE_HIGH>
        , <&pro_micro 3 GPIO_ACTIVE_HIGH>
        , <&pro_micro 2 GPIO_ACTIVE_HIGH>
        , <&pro_micro 0 GPIO_ACTIVE_HIGH>
        , <&pro_micro 1 GPIO_ACTIVE_HIGH>
        ;
};
