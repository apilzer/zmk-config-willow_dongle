## config/boards/shields/willow/Kconfig.defconfig
```kconfig
if SHIELD_WILLOW_DONGLE

config ZMK_KEYBOARD_NAME
    default "Willow USB"

config ZMK_SPLIT_ROLE_CENTRAL
    default y

config ZMK_SLEEP
    default n

endif

if SHIELD_WILLOW_DONGLE || SHIELD_WILLOW

config ZMK_SPLIT
    default y

endif
```

## config/boards/shields/willow/Kconfig.shield
```kconfig
config SHIELD_WILLOW_DONGLE
    def_bool $(shields_list_contains,willow_dongle)

config SHIELD_WILLOW
    def_bool $(shields_list_contains,willow)
```
